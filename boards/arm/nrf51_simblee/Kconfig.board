## boards/arm/nrf51_simblee/Kconfig.board
```kconfig
# Kconfig - nRF51 Simblee board configuration
#
# Copyright (c) 2018 XXX.
#
# SPDX-License-Identifier: Apache-2.0

config BOARD_NRF51_SIMBLEE
	bool "nRF51 Simblee"
	depends on SOC_NRF51822_CFAC
```

## boards/arm/nrf51_simblee/Kconfig.defconfig
```kconfig
# Kconfig - nRF51 Simblee board configuration
#
# Copyright (c) 2018 XXX.
#
# SPDX-License-Identifier: Apache-2.0

if BOARD_NRF51_SIMBLEE

config BOARD
	default "nrf51_simblee"

if ADC

config ADC_0
        default y

endif # ADC

endif # BOARD_NRF51_SIMBLEE
```

## drivers/manchester/Kconfig
```kconfig
# Manchester configuration options

# Copyright (c) 2024 Research Studios Austria Forschungsgesellschaft mbH
# SPDX-License-Identifier: Apache-2.0

#
# MANCHESTER options
#
menuconfig MANCHESTER
	bool "Serial bus driver using Manchester encoding"
	help
	  Enable Manchester encoded serial bus driver

if MANCHESTER

# Include these first so that any properties (e.g. defaults) below can be
# overridden (by defining symbols in multiple locations)
source "drivers/manchester/Kconfig.gpio"

config MANCHESTER_INIT_PRIORITY
	int "Init priority"
	default KERNEL_INIT_PRIORITY_DEVICE
	help
	  Manchester device driver initialization priority.

module = MANCHESTER
module-str = manchester
source "subsys/logging/Kconfig.template.log_config"

config MANCHESTER_BITBANG
	bool
	help
	  Enable library used for software driven (bit banging)
		Manchester serial support

endif # MANCHESTER
```

## drivers/manchester/Kconfig.gpio
```kconfig
# Copyright (c) 2024 Research Studios Austria Forschungsgesellschaft mbH
# SPDX-License-Identifier: Apache-2.0

config MANCHESTER_GPIO
	bool "GPIO bit banging Manchester support"
	default y
	depends on DT_HAS_GPIO_MANCHESTER_ENABLED
	select MANCHESTER_BITBANG
	help
	  Enable software driven (bit banging) Manchester serial communication
		support using GPIO pins
```

## drivers/sensor/melexis/mlx90614/Kconfig
```kconfig
# Copyright (c) 2025 Christian Hirsch <christian@hirsch.zone>
# SPDX-License-Identifier: Apache-2.0


config MLX90614
	bool "MLX90614 IR thermometer"
	default y
	depends on DT_HAS_MELEXIS_MLX90614_ENABLED
	select I2C
	select CRC
	help
	  Enable driver for MLX90614 IR thermometer.
```

## dts/bindings/manchester/manchester-controller.yaml
```yaml
# Copyright (c) 2024 Research Studios Austria Forschungsgesellschaft mbH
# SPDX-License-Identifier: Apache-2.0

# Common fields for Manchester controllers

include: base.yaml

bus: manchester
```

## dts/bindings/manchester/manchester-gpio.yaml
```yaml
# Copyright (c) 2024 Research Studios Austria Forschungsgesellschaft mbH
# SPDX-License-Identifier: Apache-2.0

description: GPIO bitbanging Manchester support

compatible: "gpio-manchester"

include: manchester-controller.yaml

properties:
  rx-gpios:
    type: phandle-array
    required: true
    description: GPIO to which the RX pin of the Manchester bus is connected.
  tx-gpios:
    type: phandle-array
    required: true
    description: GPIO to which the TX pin of the Manchester bus is connected.
```

## dts/bindings/sensor/melexis,mlx90614.yaml
```yaml
# Copyright (c) 2025 Christian Hirsch <christian@hirsch.zone>
# SPDX-License-Identifier: Apache-2.0

description: |
    Melexis MLX90614 IR thermometer. See datasheet at
    https://www.melexis.com/en/documents/documentation/datasheets/datasheet-mlx90614

compatible: "melexis,mlx90614"

include: [sensor-device.yaml, i2c-device.yaml]
```

## soc/arm/nordic_nrf/nrf51/Kconfig.defconfig.nrf51822_CFAC
```kconfig
# Kconfig.defconfig.nrf51822_CFAC - Nordic Semiconductor nRF51822 MCU
#
# Copyright (c) 2018 XXX
# Copyright (c) 2016 Nordic Semiconductor ASA
#
# SPDX-License-Identifier: Apache-2.0
#

if SOC_NRF51822_CFAC

config SOC
	string
	default "nRF51822_CFAC"

endif # SOC_NRF51822_CFAC
```
